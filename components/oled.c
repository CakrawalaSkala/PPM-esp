#include "oled.h"
#include "driver/i2c.h"
#include "freertos/FreeRTOS.h"
#include "freertos/task.h"

#define I2C_PORT I2C_NUM_0
#define SDA_PIN 21
#define SCL_PIN 22

#define OLED_ADDR 0x3C

static uint8_t cursor_x = 0;
static uint8_t cursor_y = 0;

/* ================= I2C ================= */

static void i2c_init()
{
    i2c_config_t conf = {
        .mode = I2C_MODE_MASTER,
        .sda_io_num = SDA_PIN,
        .scl_io_num = SCL_PIN,
        .sda_pullup_en = GPIO_PULLUP_ENABLE,
        .scl_pullup_en = GPIO_PULLUP_ENABLE,
        .master.clk_speed = 100000
    };

    i2c_param_config(I2C_PORT, &conf);
    i2c_driver_install(I2C_PORT, conf.mode, 0, 0, 0);
}

/* ================= OLED LOW LEVEL ================= */

static void oled_cmd(uint8_t cmd)
{
    i2c_cmd_handle_t h = i2c_cmd_link_create();

    i2c_master_start(h);
    i2c_master_write_byte(h, (OLED_ADDR << 1) | I2C_MASTER_WRITE, true);
    i2c_master_write_byte(h, 0x00, true);
    i2c_master_write_byte(h, cmd, true);
    i2c_master_stop(h);

    i2c_master_cmd_begin(I2C_PORT, h, pdMS_TO_TICKS(100));
    i2c_cmd_link_delete(h);
}

static void oled_data(uint8_t data)
{
    i2c_cmd_handle_t h = i2c_cmd_link_create();

    i2c_master_start(h);
    i2c_master_write_byte(h, (OLED_ADDR << 1) | I2C_MASTER_WRITE, true);
    i2c_master_write_byte(h, 0x40, true);
    i2c_master_write_byte(h, data, true);
    i2c_master_stop(h);

    i2c_master_cmd_begin(I2C_PORT, h, pdMS_TO_TICKS(100));
    i2c_cmd_link_delete(h);
}

/* ================= OLED ================= */

void oled_set_cursor(uint8_t x, uint8_t y)
{
    cursor_x = x;
    cursor_y = y;

    oled_cmd(0xB0 + y);                 // pilih page
    oled_cmd(0x00 + (x & 0x0F));        // lower column
    oled_cmd(0x10 + ((x >> 4) & 0x0F)); // higher column
}

void oled_clear()
{
    for(int page=0; page<8; page++)
    {
        oled_set_cursor(0,page);

        for(int i=0;i<128;i++)
            oled_data(0x00);
    }

    oled_set_cursor(0,0);
}

void oled_init()
{
    i2c_init();

    oled_cmd(0xAE);
    oled_cmd(0x20);
    oled_cmd(0x00);
    oled_cmd(0xB0);
    oled_cmd(0xC8);
    oled_cmd(0x00);
    oled_cmd(0x10);
    oled_cmd(0x40);
    oled_cmd(0x81);
    oled_cmd(0x7F);
    oled_cmd(0xA1);
    oled_cmd(0xA6);
    oled_cmd(0xA8);
    oled_cmd(0x3F);
    oled_cmd(0xA4);
    oled_cmd(0xD3);
    oled_cmd(0x00);
    oled_cmd(0xD5);
    oled_cmd(0xF0);
    oled_cmd(0xD9);
    oled_cmd(0x22);
    oled_cmd(0xDA);
    oled_cmd(0x12);
    oled_cmd(0xDB);
    oled_cmd(0x20);
    oled_cmd(0x8D);
    oled_cmd(0x14);
    oled_cmd(0xAF);
}

/* ================= FONT ================= */

static const uint8_t font[][5] = {

// angka
{0x3E,0x51,0x49,0x45,0x3E}, //0
{0x00,0x42,0x7F,0x40,0x00}, //1
{0x62,0x51,0x49,0x49,0x46}, //2
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{0x26,0x49,0x49,0x49,0x3E}, //9

// huruf A-Z
{0x7E,0x11,0x11,0x11,0x7E}, //A
{0x7F,0x49,0x49,0x49,0x36}, //B
{0x3E,0x41,0x41,0x41,0x22}, //C
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{0x61,0x51,0x49,0x45,0x43},  //Z

// huruf kecil a-z
{0x20,0x54,0x54,0x54,0x78}, //a
{0x7F,0x48,0x44,0x44,0x38}, //b
{0x38,0x44,0x44,0x44,0x20}, //c
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{0x44,0x64,0x54,0x4C,0x44},  //z

// karakter tambahan
{0x00,0x00,0x00,0x00,0x00}, // spasi
{0x00,0x60,0x60,0x00,0x00}, // .
{0x00,0x36,0x36,0x00,0x00}, // :
{0x08,0x08,0x08,0x08,0x08}, // -
{0x20,0x10,0x08,0x04,0x02}, // /
{0x62,0x64,0x08,0x13,0x23}  // %

};

const uint8_t epd_bitmap_logo[] = {
0x00, 0x00, 0x00, 0x00, 0x00, 0x00, 0x00, 0x00, 0x00, 0x00, 0x00, 0x00, 0x00, 0x00, 0x00, 0x00, 
	0x00, 0x00, 0x00, 0x40, 0xc0, 0xc0, 0xc0, 0xe0, 0xe0, 0xe0, 0xe0, 0xe0, 0xf0, 0xf0, 0xf0, 0xc0, 
	0x00, 0x00, 0x00, 0x00, 0x00, 0x00, 0x00, 0x00, 0x00, 0x00, 0x00, 0x00, 0x00, 0x00, 0x00, 0x00, 
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	0x00, 0x00, 0x00, 0x00, 0x00, 0x00, 0x00, 0x00, 0x00, 0x00, 0x00, 0x00, 0x00, 0x00, 0x00, 0x00
};

/* ================= PRINT ================= */

static void oled_char(char c)
{
    uint8_t index;

    if(c >= '0' && c <= '9')
        index = c - '0';

    else if(c >= 'A' && c <= 'Z')
        index = (c - 'A') + 10;

    else if(c >= 'a' && c <= 'z')
        index = (c - 'a') + 36;

    else if(c == ' ')
        index = 62;

    else if(c == '.')
        index = 63;

    else if(c == ':')
        index = 64;

    else if(c == '-')
        index = 65;

    else if(c == '/')
        index = 66;

    else if(c == '%')
        index = 67;

    else
        return;

    for(int i=0;i<5;i++)
        oled_data(font[index][i]);

    oled_data(0x00);

    cursor_x += 6;
}

void oled_draw_bitmap(const uint8_t *bitmap, uint8_t w, uint8_t h)
{
    for(int page = 0; page < h/8; page++)
    {
        oled_set_cursor(0, page);

        for(int col = 0; col < w; col++)
        {
            oled_data(bitmap[page * w + col]);
        }
    }
}

void oled_print(char *str)
{
    while(*str)
    {
        oled_char(*str);
        str++;
    }
}